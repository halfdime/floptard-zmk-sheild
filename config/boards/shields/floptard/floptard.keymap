// Tab align to 4 spaces or perish

#include <behaviors.dtsi>
#include <dt-bindings/zmk/keys.h>
#include <dt-bindings/zmk/bt.h>
#include <dt-bindings/zmk/outputs.h>

#define L_MAIN 0
#define L_GAME 1
#define L_QWERTY 2
#define L_HR_COMMON 3
#define L_HR_MAIN 4
#define L_HR_QWERTY 5
#define L_RAISE 6
#define L_LOWER 6

#define LG_HR L_HR_COMMON L_HR_MAIN L_HR_QWERTY
#define LG_TYPING L_MAIN L_QWERTY

#define DEFAULT_TAPTERM_MS 230
#define COMBO_TIMEOUT 50
#define MEANT_TO_TAP_TIME 2000

#define HRM(MOD) &ht_mod MOD 0
#define KRC(row, col) (((row) * 12) + (col))

#define BTP_SEL(PROF) &bt BT_SEL PROF
#define CAREFUL_KEY(BINDING)\
			compatible = "zmk,behavior-hold-tap";\
			#binding-cells = <2>;\
\
			flavor = "hold-preferred";\
			tapping-term-ms = <MEANT_TO_TAP_TIME>;\
			bindings = <BINDING>, <&none>;

#define COMMON_COMBO(BINDING, KEYS, LAYERS)\
			timeout-ms = <COMBO_TIMEOUT>;\
			key-positions = <KEYS>;\
			bindings = <BINDING>;\
			layers =  <LAYERS>;

&soft_off {
	hold-time-ms = <MEANT_TO_TAP_TIME>;
};

/ {
	conditional_layers {
		compatible = "zmk,conditional-layers";

		home_row_layer_main {
			if-layers = <L_MAIN L_HR_COMMON>;
			then-layer = <L_HR_MAIN>;
		};

		home_row_layer_qwerty {
			if-layers = <L_QWERTY L_HR_COMMON>;
			then-layer = <L_HR_QWERTY>;
		};
	};

	combos {
		compatible = "zmk,combos";

		// Grave and Tab
		combo_esc {COMMON_COMBO(&kp ESC, KRC(0,0) KRC(1,0), L_MAIN L_QWERTY L_GAME)};

		// LShift + Both layer keys
		combo_game_layer {COMMON_COMBO(&to L_GAME, KRC(3,0) KRC(4,0) KRC(4,7), L_MAIN L_QWERTY LG_HR)};
		combo_leave_game_layer {COMMON_COMBO(&to L_MAIN, KRC(3,0) KRC(4,0) KRC(4,7), L_GAME LG_HR)};

		// Both layer keys
		combo_qwerty_layer {COMMON_COMBO(&to L_QWERTY, KRC(4,0) KRC(4,7), L_MAIN L_GAME LG_HR)};
		combo_leave_qwerty_layer {COMMON_COMBO(&to L_MAIN, KRC(4,0) KRC(4,7), L_QWERTY LG_HR)};

		combo_home_row_mods {COMMON_COMBO(&tog L_HR_COMMON, KRC(4,0) KRC(4,7) KRC(3,11), LG_TYPING LG_HR)};
	};

	macros {
		bt_clr: bluetooth_clear_no_params {
			compatible = "zmk,behavior-macro";
			#binding-cells = <0>;
			bindings = <&bt BT_CLR>;
		};
	};

	behaviors {
		td_rs: tap_dance_rshift_rctrl {
			compatible = "zmk,behavior-tap-dance";
			#binding-cells = <0>;

			tapping-term-ms = <DEFAULT_TAPTERM_MS>;
			bindings = <&kp RSHIFT>, <&kp RCTRL>, <&kp RCTRL>, <&kp RCTRL>;
		};

		c_lboot: left_careful_boot {CAREFUL_KEY(&bootloader)};
		c_rboot: right_careful_boot {CAREFUL_KEY(&bootloader)};
		c_bt: careful_bt {CAREFUL_KEY(&bt_clr)};

		ht_key: hold_tap_keys {
			compatible = "zmk,behavior-hold-tap";
			#binding-cells = <2>;

			tapping-term-ms = <DEFAULT_TAPTERM_MS>;
			flavor = "tap-preferred";
			bindings = <&kp>, <&kp>;
		};
	};

	keymap {
		compatible = "zmk,keymap";

		qwerty_layer {
			//                                 Qwerty Layer
			// =========================================================================================
			// | [^] | [^] | [^] | [^] | [^] | [^] | ║ | [^] | [^] | [^] | [^] | [^] | [^] |
			// | [^] |  Q  |  W  |  E  |  R  |  T  | ║ |  Y  |  U  |  I  |  O  |  P  | [^] |
			// | [^] |  A  |  S  |  D  |  F  |  G  | ║ |  H  |  J  |  K  |  L  |  ;  | [^] |
			// | [^] |  Z  |  X  |  C  |  V  |  B  | ║ |  N  |  M  |  ,  |  .  |  /  | [^] |
			//             | [^] | [^] | [^] | [^] | ║ | [^] | [^] | [^] | [^] |

			bindings = <
				&kp GRAVE	&kp N1	&kp N2	&kp N3	&kp N4	&kp N5	/*║*/	&kp N6	&kp N7	&kp N8		&kp N9		&kp N0
				&kp TAB		&kp Q	&kp W	&kp E	&kp R	&kp T	/*║*/	&kp Y	&kp U	&kp I		&kp O		&kp P				&kp BSLH
				&kp LCTRL	&kp A	&kp S	&kp D	&kp F	&kp G	/*║*/	&kp H	&kp J	&kp K		&kp L		&kp SEMI			&kp RET
				&kp LSHFT	&kp Z	&kp X	&kp C	&kp V	&kp B	/*║*/	&kp N	&kp M	&kp COMMA	&kp DOT		&ht_key SQT FSLH	&td_rs
						&mo L_LOWER	&kp SPACE	&kp LALT	&kp LGUI	/*║*/	&kp RGUI	&kp RALT	&kp SPACE	&mo L_RAISE
			>;
		};

		game_layer {
			//                                   Game Layer
			// =========================================================================================
			// | [^] | [^]  | [^] | [^] | [^] | [^] | ║ | [^] | [^] | [^] | [^] | [^] | [^] |
			// |  T  | TAB  |  Q  |  W  |  E  |  R  | ║ |  Y  |  U  |  I  |  O  |  P  | [^] |
			// |  G  | CTRL |  A  |  S  |  D  |  F  | ║ |  H  |  J  |  K  |  L  |  ;  | [^] |
			// |  B  | SHFT |  Z  |  X  |  C  |  V  | ║ |  N  |  M  |  ,  |  .  |  /  | [^] |
			//              | [^] | [^] | [^] | [^] | ║ | [^] | [^] | [^] | [^] |

			bindings = <
				&trans	&trans		&trans	&trans	&trans	&trans	/*║*/	&trans	&trans	&trans		&trans		&trans				&trans
				&kp T	&kp TAB		&kp Q	&kp W	&kp E	&kp R	/*║*/	&kp Y	&kp U	&kp I		&kp O		&kp P				&trans
				&kp G	&kp LCTRL	&kp A	&kp S	&kp D	&kp F	/*║*/	&kp H	&kp J	&kp K		&kp L		&kp SEMI			&trans
				&kp B	&kp LSHFT	&kp Z	&kp X	&kp C	&kp V	/*║*/	&kp N	&kp M	&kp COMMA	&kp DOT		&ht_key SQT FSLH	&trans
									&trans	&trans	&trans	&trans	/*║*/	&trans	&trans	&trans		&trans
			>;
		};

		default_layer {
			//                                    Main Layer
			// =========================================================================================
			// |  ~   |  1  |  2  |  3  |  4  |  5  | ║ |  6  |  7  |  8  |  9  |  0  |    BKSP   |
			// | TAB  |  Q  |  W  |  F  |  P  |  B  | ║ |  J  |  L  |  U  |  Y  |  ;  |     \     |
			// | CTRL |  A  |  R  |  S  |  T  |  G  | ║ |  M  |  N  |  E  |  I  |  O  |    ENTR   |
			// | SHFT |  Z  |  X  |  C  |  D  |  V  | ║ |  K  |  H  |  ,  |  .  |  /  | SHFT/CTRL |
			//              | GUI | SPC | ALT | L_? | ║ | L_? | ALT | SPC | GUI |

			bindings = <
				&kp GRAVE	&trans	&trans		&trans		&trans		&trans		/*║*/	&trans	&trans	&trans		&trans		&trans				&trans
				&kp TAB		&kp Q	&kp W		&kp F		&kp P		&kp B		/*║*/	&kp J		&kp L		&kp U		&kp Y		&kp SEMI			&kp BSLH
				&kp LCTRL	&kp A	&kp R		&kp S		&kp T		&kp G		/*║*/	&kp M		&kp N		&kp E		&kp I		&kp O				&kp RET
				&kp LSHFT	&kp Z	&kp X		&kp C		&kp D		&kp V		/*║*/	&kp K		&kp H		&kp COMMA	&kp DOT		&ht_key SQT FSLH	&td_rs
							&trans	&trans	&trans	&trans					/*║*/	&trans	&trans	&trans		&trans
			>;
		};

		homerow_common {
			bindings = <
				&trans	&trans	&trans	&trans	&trans	&trans	/*║*/	&trans	&trans	&trans	&trans	&trans	&trans
				&trans	&trans	&trans	&trans	&trans	&trans	/*║*/	&trans	&trans	&trans	&trans	&trans	&trans
				&trans	&trans	&trans	&trans	&trans	&trans	/*║*/	&trans	&trans	&trans	&trans	&trans	&trans
				&trans	&trans	&trans	&trans	&trans	&trans	/*║*/	&trans	&trans	&trans	&trans	&trans	&trans
								&trans	&trans	&trans	&trans	/*║*/	&trans	&trans	&trans	&trans
			>;
		};

		homerow_mods_default {
			bindings = <
				&trans	&trans			&trans			&trans			&trans			&trans	/*║*/	&trans	&trans			&trans			&trans			&trans			&trans
				&trans	&trans			&trans			&trans			&trans			&trans	/*║*/	&trans	&trans			&trans			&trans			&trans			&trans
				&trans	&ht_key LSHFT A	&ht_key LCTRL R	&ht_key LGUI S	&ht_key LALT T	&trans	/*║*/	&trans	&ht_key RALT N	&ht_key RGUI E	&ht_key RCTRL I	&ht_key RSHFT O	&trans
				&trans	&trans			&trans			&trans			&trans			&trans	/*║*/	&trans	&trans			&trans			&trans			&trans			&trans
										&trans			&trans			&trans			&trans	/*║*/	&trans	&trans			&trans			&trans
			>;
		};

		homerow_mods_qwerty {
			bindings = <
				&trans	&trans			&trans			&trans			&trans			&trans	/*║*/	&trans	&trans			&trans			&trans			&trans				&trans
				&trans	&trans			&trans			&trans			&trans			&trans	/*║*/	&trans	&trans			&trans			&trans			&trans				&trans
				&trans	&ht_key LSHFT A	&ht_key LCTRL S	&ht_key LGUI D	&ht_key LALT F	&trans	/*║*/	&trans	&ht_key RALT J	&ht_key RGUI K	&ht_key RCTRL L	&ht_key RSHFT SEMI	&trans
				&trans	&trans			&trans			&trans			&trans			&trans	/*║*/	&trans	&trans			&trans			&trans			&trans				&trans
										&trans			&trans			&trans			&trans	/*║*/	&trans	&trans			&trans			&trans
			>;
		};

		lower_layer {
			//                                    Main Layer
			// ============================================================================================
			// | ESC |  FN1  |  FN2  |  FN3  |  FN4  | FN5 | ║ | FN6  | FN7  | FN8  | FN9  | F10 |  DEL  |
			// | [^] |  OFF  |  BOOT | OUT_U | OUT_B |     | ║ |  -   |  =   |  [   |  ]   | F11 | BOOT  |
			// | [^] | VOLDN | VOLUP |  RWD  | PAUSE | FWD | ║ | LEFT | DOWN |  UP  | RGHT | F12 | QUOTE |
			// | [^] |  BT0  |  BT1  |  BT2  |  BT3  | BTC | ║ | HOME | PGDN | PGUP | END  | PRT |  [^]  |
			//               |  [^]  |  [^]  |  [^]  | [^] | ║ | [^]  | [^]  | [^]  | [^]  |
 
			bindings = <
				&kp ESC	&kp F1			&kp F2			&kp F3			&kp F4			&kp F5		/*║*/	&kp F6		&kp F7		&kp F8		&kp F9		&kp F10		&kp DEL
				&trans	&soft_off		&c_lboot 0 0	&out OUT_USB	&out OUT_BLE	&none		/*║*/	&kp MINUS	&kp EQUAL	&kp LBKT	&kp RBKT	&kp F11		&none
				&trans	&kp C_VOL_DN	&kp C_VOL_UP	&kp C_PREV		&kp C_PP		&kp C_NEXT	/*║*/	&kp LEFT	&kp DOWN	&kp UP		&kp RIGHT	&kp F12		&kp SQT
				&trans	BTP_SEL(0)		BTP_SEL(1)		BTP_SEL(2)		BTP_SEL(3)		&c_bt 0 0	/*║*/	&kp HOME	&kp PG_DN	&kp PG_UP	&kp END		&kp PSCRN	&trans
										&trans			&trans			&trans			&trans		/*║*/	&trans		&trans		&trans		&trans
			>;
		};
	};
};
