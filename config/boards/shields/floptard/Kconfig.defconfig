## config/boards/shields/floptard/Kconfig.defconfig
```kconfig
if SHIELD_FLOPTARD_LEFT
	config ZMK_KEYBOARD_NAME
		default "Floptard"

	config ZMK_SPLIT_ROLE_CENTRAL
		default y
endif

if SHIELD_FLOPTARD_LEFT || SHIELD_FLOPTARD_RIGHT
	config ZMK_SPLIT
		default y
endif
```

## config/boards/shields/floptard/Kconfig.shield
```kconfig
config SHIELD_FLOPTARD_LEFT
	def_bool $(shields_list_contains,floptard_left)

config SHIELD_FLOPTARD_RIGHT
	def_bool $(shields_list_contains,floptard_right)
```
